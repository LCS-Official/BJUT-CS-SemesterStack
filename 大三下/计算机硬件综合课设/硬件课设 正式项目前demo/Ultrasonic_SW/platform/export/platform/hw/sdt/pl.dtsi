/ {
	amba_pl: amba_pl {
		ranges;
		compatible = "simple-bus";
		#address-cells = <1>;
		#size-cells = <1>;
		myUltrasonic_0: myUltrasonic@43c00000 {
			compatible = "xlnx,myUltrasonic-1.0";
			xlnx,input-clk-hz = <100000000>;
			xlnx,rable = <0>;
			xlnx,s00-axi-data-width = <32>;
			xlnx,ip-name = "myUltrasonic";
			reg = <0x43c00000 0x10000>;
			clocks = <&clkc 15>;
			xlnx,t-overtime-us = <40000>;
			xlnx,edk-iptype = "PERIPHERAL";
			xlnx,t-trig-us = <10>;
			status = "okay";
			clock-names = "s00_axi_aclk";
			xlnx,s00-axi-addr-width = <4>;
			xlnx,name = "myUltrasonic_0";
		};
	};
};
